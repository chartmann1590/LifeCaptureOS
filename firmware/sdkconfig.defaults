## firmware/sdkconfig.defaults
```kconfig
# ESP32-CAM Configuration

# Flash size
CONFIG_ESPTOOLPY_FLASHSIZE_4MB=y
CONFIG_ESPTOOLPY_FLASHSIZE="4MB"
CONFIG_ESPTOOLPY_FLASHFREQ_40M=y
CONFIG_ESPTOOLPY_FLASHMODE_DIO=y

# PSRAM (disabled - chip doesn't support it)
CONFIG_ESP32_SPIRAM_SUPPORT=n
# CONFIG_SPIRAM_USE_MALLOC=y
# CONFIG_SPIRAM_TYPE_AUTO=y
# CONFIG_SPIRAM_SPEED_40M=y
# CONFIG_SPIRAM_MEMTEST=y

# Camera
CONFIG_CAMERA_CORE0=y
CONFIG_CAMERA_DMA_BUFFER_SIZE_MAX=32768

# Partition table
CONFIG_PARTITION_TABLE_SINGLE_APP_LARGE=y

# WiFi
CONFIG_ESP32_WIFI_DYNAMIC_TX_BUFFER_NUM=32
CONFIG_ESP32_WIFI_STATIC_RX_BUFFER_NUM=10
CONFIG_ESP32_WIFI_DYNAMIC_RX_BUFFER_NUM=32

# Bluetooth - Use NimBLE instead of Bluedroid for lower memory usage
CONFIG_BT_ENABLED=y
CONFIG_BT_NIMBLE_ENABLED=y
CONFIG_BT_BLUEDROID_ENABLED=n
CONFIG_BTDM_CTRL_MODE_BLE_ONLY=y
CONFIG_BTDM_CTRL_MODE_BR_EDR_ONLY=n
CONFIG_BTDM_CTRL_MODE_BTDM=n

# NimBLE optimizations
CONFIG_BT_NIMBLE_PINNED_TO_CORE_0=y
CONFIG_BT_NIMBLE_MEM_ALLOC_MODE_INTERNAL=y
CONFIG_BT_NIMBLE_LOG_LEVEL_WARNING=y

# BT memory optimization
CONFIG_BT_RELEASE_IRAM=y
CONFIG_BTDM_CTRL_HLI=n

# WiFi IRAM optimization
CONFIG_ESP_WIFI_IRAM_OPT=n
CONFIG_ESP_WIFI_RX_IRAM_OPT=n

# Compiler optimization for size
CONFIG_COMPILER_OPTIMIZATION_SIZE=y
CONFIG_COMPILER_OPTIMIZATION_PERF=n

# Event loop optimization
CONFIG_ESP_EVENT_LOOP_PROFILING=n

# System optimizations
CONFIG_ESP_SYSTEM_EVENT_TASK_STACK_SIZE=2048

# FreeRTOS
CONFIG_FREERTOS_HZ=1000

# Debug
CONFIG_LOG_DEFAULT_LEVEL_INFO=y

# FATFS - enable long filenames for media capture
CONFIG_FATFS_LFN_HEAP=y
CONFIG_FATFS_MAX_LFN=64
# CONFIG_FATFS_LFN_NONE is not set
# CONFIG_FATFS_LFN_STACK is not set
```
